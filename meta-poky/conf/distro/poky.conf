## meta-poky/conf/distro/poky.conf
```bitbake
DISTRO = "poky"
DISTRO_NAME = "Poky (Yocto Project Reference Distro)"
DISTRO_VERSION = "6.1.99+snapshot-${METADATA_REVISION}"
DISTRO_CODENAME = "garburn"
SDK_VENDOR = "-pokysdk"
SDK_VERSION = "${@d.getVar('DISTRO_VERSION').replace('snapshot-${METADATA_REVISION}', 'snapshot')}"
SDK_VERSION[vardepvalue] = "${SDK_VERSION}"

MAINTAINER = "Poky Maintainers <poky@lists.yoctoproject.org>"

TARGET_VENDOR = "-poky"

LOCALCONF_VERSION = "2"

# Override these in poky based distros
POKY_DEFAULT_DISTRO_FEATURES = ""
POKY_DEFAULT_EXTRA_RDEPENDS = "packagegroup-core-boot"
POKY_DEFAULT_EXTRA_RRECOMMENDS = "kernel-module-af-packet"

DISTRO_FEATURES ?= "${POKY_DEFAULT_DISTRO_FEATURES}"

PREFERRED_VERSION_linux-yocto ?= "7.2%"
PREFERRED_VERSION_linux-yocto-rt ?= "7.2%"

SDK_NAME = "${DISTRO}-${TCLIBC}-${SDKMACHINE}-${IMAGE_BASENAME}-${TUNE_PKGARCH}-${MACHINE}"
SDKPATHINSTALL = "/opt/${DISTRO}/${SDK_VERSION}"

DISTRO_EXTRA_RDEPENDS += "${POKY_DEFAULT_EXTRA_RDEPENDS}"
DISTRO_EXTRA_RRECOMMENDS += "${POKY_DEFAULT_EXTRA_RRECOMMENDS}"

PACKAGE_CLASSES ?= "package_rpm"

SANITY_TESTED_DISTROS ?= " \
            poky-6.1 \n \
            ubuntu-22.04 \n \
            ubuntu-24.04 \n \
            ubuntu-25.04 \n \
            ubuntu-25.10 \n \
            ubuntu-26.04 \n \
            fedora-43 \n \
            fedora-44 \n \
            fedora-45 \n \
            centos-9 \n \
            centos-10 \n \
            debian-12 \n \
            debian-13 \n \
            opensuseleap-16.0 \n \
            almalinux-8.10 \n \
            almalinux-9.8 \n \
            almalinux-10.2 \n \
            rocky-8 \n \
            rocky-9 \n \
            rocky-10 \n \
            "

# QA check settings - a little stricter than the OE-Core defaults
# (none currently necessary as we now match OE-Core)
#WARN_TO_ERROR_QA = "X"
#WARN_QA:remove = "${WARN_TO_ERROR_QA}"
#ERROR_QA:append = " ${WARN_TO_ERROR_QA}"

require conf/distro/include/poky-world-exclude.inc

BB_SIGNATURE_HANDLER ?= "OEEquivHash"
BB_HASHSERVE ??= "auto"

POKY_INIT_MANAGER = "sysvinit"
INIT_MANAGER ?= "${POKY_INIT_MANAGER}"

# We need debug symbols so that SPDX license manifests for the kernel work
KERNEL_EXTRA_FEATURES:append = " features/debug/debug-kernel.scc"
```

## meta-poky/conf/layer.conf
```bitbake
LAYERNAME = "meta-yocto-poky"
LAYERVERSION = "3"
LAYERSERIES_COMPAT = "blacksail"
LAYERDEPENDS = "oe-core"
```

## meta-yocto-bsp/conf/layer.conf
```bitbake
LAYERNAME = "meta-yocto-bsp"
LAYERVERSION = "4"
LAYERSERIES_COMPAT = "blacksail"
```
